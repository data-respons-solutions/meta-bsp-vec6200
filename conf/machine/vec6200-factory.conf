## conf/machine/vec6200-factory.conf
```bitbake
#@TYPE: Machine
#@NAME: i.MX6Q Data Respons VEC6200
#@DESCRIPTION: Factory Machine configuration for VEC6200
#@SOC: i.MX6DL

require vec6200.conf

DISTRO = "factory-distro"

MACHINE_ESSENTIAL_EXTRA_RDEPENDS += "factory-install"

FACTORY_IMAGE_INSTALL = "\
	kernel-image \
	devicetree \
	u-boot \
"

FACTORY_DEVICETREE = "vec6200-dl-revA.dtb"
```

## conf/machine/vec6200.conf
```bitbake
#@TYPE: Machine
#@NAME: i.MX6Q Data Respons VEC6200
#@DESCRIPTION: Machine configuration for VEC6200
#@SOC: i.MX6DL

MACHINEOVERRIDES =. "use-mainline-bsp:"

require conf/machine/include/imx-base.inc
require conf/machine/include/tune-cortexa9.inc

DISTRO ?= "datarespons-distro"

SYSTEM_NAME="vec6200"

IMAGE_FSTYPES = "tar.bz2"
INITRAMFS_MAXSIZE = "400000"
INITRAMFS_FSTYPES = "cpio.gz.u-boot"

SERIAL_CONSOLES = "115200;ttymxc0"

UBOOT_CONFIG ??= "production"
UBOOT_CONFIG[production] = "vec6200_defconfig"
UBOOT_MAKE_TARGET = ""

# Simplify MACHINE_FEATURES during development to keep down initramfs size
#MACHINE_FEATURES = "rtc pci wifi 3g bluetooth ext2 vfat usbgadget usbhost screen gps tpm2"
MACHINE_FEATURES = "rtc pci ext2 vfat usbgadget usbhost"
MACHINE_ESSENTIAL_EXTRA_RDEPENDS += "devicetree"
MACHINE_ESSENTIAL_EXTRA_RRECOMMENDS += "nvram kernel-modules kernel-module-vehicle-smc kernel-module-user-gpios kernel-module-fsl-otp"
MACHINE_EXTRA_RRECOMMENDS += "flash-uboot udev-rules"

NVRAM_INTERFACE ?= "mtd"
NVRAM_MTD_WP ?= "/sys/class/gpio/gpio134/value"

PREFERRED_PROVIDER_virtual/bootloader = "u-boot"
PREFFERED_VERSION_u-boot = "2020.04"

PREFERRED_PROVIDER_virtual/kernel = "linux-mainline"
PREFFERED_VERSION_linux-mainline = "5.4."

KERNEL_IMAGETYPE = "zImage"
# meta-freescale breaks build due to hard dependency for KERNEL_DEVICETREE.
# We remove the the dependency to allow building devicetree out-of-tree.
IMAGE_BOOT_FILES = "${KERNEL_IMAGETYPE}"

VOLATILE_LOG_DIR="no"
```
